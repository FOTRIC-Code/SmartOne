## buildroot/package/discovery_app/Config.in
```kconfig
config BR2_PACKAGE_DISCOVERY_APP
	bool "discovery_app"
	help
	  Parkia.Cube LAN UDP multicast device discovery (239.255.255.250:9712).
```

## buildroot/package/fab_app/Config.in
```kconfig
config BR2_PACKAGE_FAB_APP
	bool "fab_app"
	help
	  Parkia.Cube factory/production app (HSI, seal, CPU serial on :8088).
```

## buildroot/package/main_app/Config.in
```kconfig
config BR2_PACKAGE_MAIN_APP
	bool "main_app"
	select BR2_PACKAGE_DBUS
	select BR2_PACKAGE_RKWIFIBT_APP
	help
	  Parkia.Cube main entry-point daemon. Handles BLE advertising,
	  GATT service, Wi-Fi credential reception, and triggers net_app
	  once provisioning succeeds.
```

## buildroot/package/net_app/Config.in
```kconfig
config BR2_PACKAGE_NET_APP
	bool "net_app"
	select BR2_PACKAGE_LIBUSB
	select BR2_PACKAGE_OPENSSL
	help
	  Parkia.Cube network application (HTTP API, provisioning, Wi-Fi, RTSP).
	  BLE provisioning is handled by main_app.
```
